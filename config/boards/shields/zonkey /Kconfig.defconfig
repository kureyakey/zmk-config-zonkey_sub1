## config/boards/shields/zonkey /Kconfig.defconfig
```kconfig
if SHIELD_zonkey_RIGHT

config ZMK_KEYBOARD_NAME
    default "zonkey"

config ZMK_SPLIT_ROLE_CENTRAL
    default y

config ZMK_SPLIT_BLE_CENTRAL_PERIPHERALS
    default 1
    
config BT_MAX_CONN
    default 5

endif

if SHIELD_ZONKEY_LEFT || SHIELD_ZONKEY_RIGHT

config ZMK_SPLIT
    default y

endif
```

## config/boards/shields/zonkey /Kconfig.shield
```kconfig
config SHIELD_ZONKEY_RIGHT
    def_bool $(shields_list_contains,zonkey_right)

config SHIELD_ZONKEY_LEFT
    def_bool $(shields_list_contains,zonkey_left)
```

## config/west.yml
```yaml
manifest:
  remotes:
    - name: zmkfirmware
      url-base: https://github.com/zmkfirmware
    - name: kureyakey
      url-base: https://github.com/kureyakey/
    - name: caksoylar 
      url-base: https://github.com/caksoylar
    - name: mctechnology17
      url-base: https://github.com/mctechnology17
      
      projects:
    - name: zmk
      remote: zmkfirmware
      revision: v0.3
      import: app/west.yml
    - name: cirque-input-module
      remote: kureyakey
      revision: main
    - name: zmk-rgbled-widget
      remote: caksoylar
      revision: main
    - name: zmk-oled-adapter
      remote: mctechnology17
      revision: main
      self:
    path: config
```
